## drivers/huawei-sensors/Kconfig
```kconfig
menu "Huawei Honor/U8800Pro Sensors Drivers"

source "drivers/huawei-sensors/accelerometer/Kconfig"
source "drivers/huawei-sensors/compass/Kconfig"
source "drivers/huawei-sensors/gyroscope/Kconfig"
source "drivers/huawei-sensors/proximity/Kconfig"

endmenu
```

## drivers/huawei-sensors/compass/Kconfig
```kconfig
#
# Huawei Honor/U8800Pro Compass & Others Drivers Configuration
#


menu "Huawei Honor/U8800Pro Compass & Others Drivers"

config HUAWEI_FEATURE_TPA2028D1_AMPLIFIER
	tristate "tpa2028d1 amplifier"
	depends on HUAWEI_KERNEL
	default y
	help
	 tpa2028d1 amplifier used for audio.

config HUAWEI_FEATURE_SENSORS_ST_LSM303DLH
	tristate "LSM303DLH is a 6D sensors(gs&ms)"
	depends on HUAWEI_KERNEL
	default n
	help
	 The LSM303DLH is a system-in-package featuring a 3D
	 digital linear acceleration sensor and a 3D digital magnetic sensor.

config HUAWEI_FEATURE_SENSORS_AK8975
	tristate "AK8975"
	depends on HUAWEI_KERNEL
	default n
	help
	  If you say yes here you get support for Asahi Kasei's 
	  orientation sensor AK8975.

endmenu
```

## drivers/huawei-sensors/proximity/Kconfig
```kconfig
#
# Huawei Honor/U8800Pro Proximity Drivers Configuration
#

menu "Huawei Honor/U8800Pro Proximity Drivers"

config  HUAWEI_FEATURE_PROXIMITY_EVERLIGHT_APS_12D
	depends on HUAWEI_KERNEL
	default n
	tristate "EVERLIGHT APS-12D Proximity"
	help
         Say Y here if you have a everlight aps-12d proximity.
          If unsure, say N.
          To compile this driver as a module, choose M here: the
          module will be called aps-12d.

config  HUAWEI_FEATURE_PROXIMITY_EVERLIGHT_APS_9900
        depends on HUAWEI_KERNEL
        default n
        tristate "EVERLIGHT APS-9900 Proximity"
        help
         Say Y here if you have a everlight aps-12d proximity.

          If unsure, say N.

          To compile this driver as a module, choose M here: the
          module will be called aps-9900.
endmenu
```

## drivers/media/video/msm/Kconfig
```kconfig
config MSM_CAMERA_V4L2
        bool "MSM Camera V4L2 Interface"
        depends on MSM_CAMERA
        default n
        ---help---
          This flag enables V4L2 interface of MSM
          camera driver. If enabled, application interacts
          with /dev/video0 through V4L2 APIs. Otherwise,
          native APIs are used through /dev/config0, /dev/frame0,
          and /dev/control0.

comment "Camera Sensor Selection"

config HUAWEI_CAMERA
	bool "HUAWEI_CAMERA "
	depends on MSM_CAMERA && !ARCH_MSM8X60 && !ARCH_MSM8960 && !MSM_CAMERA_V4L2
	default n
	---help---
	  Huawei Camera 

config HUAWEI_CAMERA_SENSOR_S5K5CA
	tristate "s5k5ca is used"
	default n
	help
	if Y ,select HUAWEI_CAMERA_SENSOR_S5K5CA

config HUAWEI_CAMERA_SENSOR_MT9T113
	tristate "mt9t113 is used"
	default n
	help
	if Y ,select HUAWEI_CAMERA_SENSOR_MT9T113

config MT9T013
	bool "Sensor mt9t013 (BAYER 3M)"
	depends on MSM_CAMERA && !ARCH_MSM8X60 && !ARCH_MSM8960 && !MSM_CAMERA_V4L2
	default y
	---help---
	  MICRON 3M Bayer Sensor with AutoFocus

config HUAWEI_CAMERA_SENSOR_MT9D113
	bool "Sensor mt9d113 (YUV 2M)"
	default n
	---help---
	  MICRON 2M YUV Sensor
	  This sensor is the front camera on QT8660.
	  This uses csi mipi interface.
	  This sensor is used only on QT device.

config HUAWEI_CAMERA_SENSOR_MT9V113
	tristate "mt9v113 is used"
	default n
	help
	if Y ,select HUAWEI_CAMERA_SENSOR_MT9V113

config MT9D112
	bool "Sensor mt9d112 (YUV 2M)"
	depends on MSM_CAMERA && !ARCH_MSM8X60 && !ARCH_MSM8960 && !MSM_CAMERA_V4L2
	default y
	---help---
	  MICRON 2M YUV Sensor

config  HUAWEI_CAMERA
	bool "Select huawei camera"
	depends on MSM_CAMERA
	depends on HUAWEI_KERNEL
	default n
	---help---
	  Select huawei camera

config HUAWEI_SENSOR_HI701
	bool "Sensor Hynix (YUV 30W)"
	depends on HUAWEI_CAMERA
	default n
	---help---
	  Hynix 30w YUV Sensor

config HUAWEI_SENSOR_OV7690
	bool "Sensor ov7690 (YUV 30K)"
	depends on HUAWEI_CAMERA
	default n
	---help---
	  MICRON 30k YUV Sensor

config HUAWEI_SENSOR_OV7736
	bool "Sensor ov7736 (YUV 30W)"
	depends on HUAWEI_CAMERA
	default n
	---help---
	  MICRON 30W YUV Sensor
	  
config HUAWEI_SENSOR_HIMAX0356
	bool "Sensor himax (YUV 30W)"
	depends on HUAWEI_CAMERA
	default n
	---help---
	  HIMAX 30w YUV Sensor
	  
config HUAWEI_SENSOR_MT9D113
	bool "Sensor Aptina (YUV 200W)"
	depends on HUAWEI_CAMERA
	default n
	---help---
	  Aptina 200w YUV Sensor

config HUAWEI_SENSOR_MT9V114
	bool "Sensor Aptina (YUV 30W)"
	depends on HUAWEI_CAMERA
	default n
	---help---
	  Aptina 30w YUV Sensor

config HUAWEI_SENSOR_MT9P017
	bool "Sensor mt9p017 (BAYER 5M)"
	depends on HUAWEI_CAMERA
	default n
	---help---
	  Sunny 5M Bayer Sensor with AutoFocus

config HUAWEI_SENSOR_S5K4E1GX_P
	bool "Sensor s5k4e1gx (BAYER 5M)"
	depends on HUAWEI_CAMERA
	default n
	---help---
	  MICRON 5M Bayer Sensor with AutoFocus
	  
config HUAWEI_SENSOR_OV5647_SUNNY
	bool "Sensor ov5647_sunny (BAYER 5M)"
	depends on HUAWEI_CAMERA
	default n
	---help---
	  MICRON 5M Bayer Sensor with AutoFocus
	  
config HUAWEI_FEATURE_RIGHT_TPA2028D1_AMPLIFIER
	tristate "right tpa2028d1 amplifier"
	depends on HUAWEI_KERNEL
	default y
	---help---
	  tpa2028d1 amplifier used for audio.
config OEM_CAMERA
    bool "use oem camera feature"
    default y
config USE_QUP_I2C
    bool "use qup i2c feature"
    default y    
config SENSOR_MC7
    bool "Fujitsu MC7 ISP (BAYER 5M)"
    default n
config SENSOR_CE147
    bool "NEC ISP (BAYER 5M)"
    default n
config SENSOR_S5K4ECGX
    bool "LSI (BAYER 5M)"
    default n
config SENSOR_S5KA3DFX
    bool "LSI CIS (VGA)"
    default n  
config MT9T013
	bool "Sensor mt9t013 (BAYER 3M)"
	depends on MSM_CAMERA && !ARCH_MSM8X60 && !MSM_CAMERA_V4L2
	default y
	---help---
	  MICRON 3M Bayer Sensor with AutoFocus
config MT9D112
	bool "Sensor mt9d112 (YUV 2M)"
	depends on MSM_CAMERA && !ARCH_MSM8X60 && !MSM_CAMERA_V4L2
	default y
	---help---
	  MICRON 2M YUV Sensor
config IMX074
	bool "Sensor IMX074 (BAYER 13.5M)"
	depends on MSM_CAMERA && ARCH_MSM8X60 && !MSM_CAMERA_V4L2
	default y
	---help---
	SONY 13.5 MP Bayer Sensor
config SENSOR_S5K5CCAF
	bool "Sensor s5k5cc 1/5 (3M/AF)"
	default n
	---help---
	  SAMSUNG 3M CMOS Sensor
config WEBCAM_OV7692
	bool "Sensor OV7692 (VGA YUV)"
	depends on MSM_CAMERA && ARCH_MSM8X60 && !MSM_CAMERA_V4L2
	default y
	---help---
	  Omni Vision VGA YUV Sensor.
#	This Senosr is used as a webcam.
#	This uses the CSI interface.
#	Need to enable CSI1 clks for this sensor.
config VX6953
	bool "Sensor VX6953 (BAYER 5M)"
	depends on MSM_CAMERA && ARCH_MSM7X30
	default y
	---help---
	STM 5M Bayer Sensor with EDOF
config SN12M0PZ
	bool "Sensor sn12m0pz (Bayer 12 MP)"
	depends on MSM_CAMERA && ARCH_MSM7X30 && !MSM_CAMERA_V4L2
	default y
	---help---
	  Sony 12 MP Bayer Sensor
config MT9P012
	bool "Sensor mt9p012 (BAYER 5M)"
	depends on MSM_CAMERA && !ARCH_MSM8X60 && !MSM_CAMERA_V4L2
	default y
	---help---
	  MICRON 5M Bayer Sensor with Autofocus

choice
	prompt "AF module"
	depends on MT9P012 && !ARCH_MSM8X60 && !MSM_CAMERA_V4L2
	default MSM_CAMERA_AF_FOXCONN

config MSM_CAMERA_AF_FOXCONN
	bool "FOXCONN Module"
	help
	  This driver supports FOXCONN AF module for 5M Bayer sensor

config MSM_CAMERA_AF_BAM
	bool "BAM Module"
	help
	  This driver supports BAM AF module for 5M Bayer sensor

endchoice

config MT9P012_KM
	bool "Sensor mt9p012 KM module (BAYER 5M)"
	depends on MSM_CAMERA && !ARCH_MSM8X60 && !MSM_CAMERA_V4L2
	default y
	---help---
	  MICRON 5M Bayer Sensor KM modules with Autofocus

config MT9E013
	bool "Sensor mt9e013 module (BAYER 8M)"
	depends on MSM_CAMERA && ARCH_MSM7X30 && !MSM_CAMERA_V4L2
	default y
	---help---
	  Aptina 8M Bayer Sensor modules with Autofocus

config HUAWEI_SENSOR_MT9E013
	bool "Sensor mt9e013 module (BAYER 8M)"
	depends on HUAWEI_CAMERA
	default y
	---help---
	  Aptina 8M Bayer Sensor modules with Autofocus

config S5K3E2FX
	bool "Sensor s5k3e2fx (Samsung 5M)"
	depends on MSM_CAMERA && !ARCH_MSM8X60 && !MSM_CAMERA_V4L2
	default y
	---help---
	  Samsung 5M with Autofocus
	  
config HUAWEI_SENSOR_S5K4E1
	bool "Sensor Sensor s5k4e1 (Samsung 5M)"
	depends on MSM_CAMERA
	default n
	---help---
	  Support for S5k4E1 samsung sensor driver.
	  It is a Bayer 5MP sensor with auto focus and it supports
	  two mipi lanes, required for msm7x2xA platform.
	  Say Y here if this is msm7x2xA variant platform.
	  
config VB6801
	bool "Sensor vb6801"
	depends on MSM_CAMERA && !ARCH_MSM8X60 && !MSM_CAMERA_V4L2
	---help---
	  5M with flash

config MSM_CAMERA_FLASH
	bool "Qualcomm MSM camera flash support"
	depends on MSM_CAMERA
	default y
	---help---
	  Enable support for LED flash for msm camera

config HUAWEI_FEATURE_TPS61310
	tristate "TPS61310"
	depends on HUAWEI_KERNEL
	default n
	help
	  tps61310 LED camera flash and video light
	  
config HW_TORCH
	bool "HUAWEI torch support"
	depends on MSM_CAMERA_FLASH
	default n
	---help---
	  Enable support for LED flash for torch
	  
config MSM_GEMINI
	tristate "Qualcomm MSM Gemini Jpeg Engine support"
	depends on MSM_CAMERA && (ARCH_MSM7X30 || ARCH_MSM8X60)
	default M
	---help---
	  Enable support for Gemini Jpeg Engine

config MSM_VPE
	tristate "Qualcomm MSM Video Pre-processing Engine support"
	depends on MSM_CAMERA && (ARCH_MSM7X30 || ARCH_MSM8X60)
	default y
	---help---
	  Enable support for Video Pre-processing Engine

config QUP_EXCLUSIVE_TO_CAMERA
	bool "QUP exclusive to camera"
	depends on MSM_CAMERA
	default y
	---help---
	  This flag enabled states that QUP
	  is exclusive to camera. In case this
	  is disabled, the lvs1 voltage is enabled
	  by QUP in the board file as QUP is used by
	  applications other than camera.
config SENSOR_SR030PC30
	bool "use VGS camera feature"
	default n

config SENSOR_SR030PC30_T679
	bool "use T679 VGS camera feature"
	default n	
config SENSOR_SR130PC10
	bool "use SGH-I847[Apache ATT] VGA camera feature"
	default n
```
